## cpu/cc26x2_cc13x2/Kconfig
```kconfig
# SPDX-FileCopyrightText: 2020 Locha Inc
# SPDX-License-Identifier: LGPL-2.1-only

config CPU_FAM_CC13X2
    bool
    select CPU_COMMON_CC26XX_CC13XX
    select CPU_FAM_CC13XX
    select CPU_CORE_CORTEX_M4F

## CPU Models
config CPU_MODEL_CC1312R1F3
    bool
    select CPU_FAM_CC13X2

config CPU_MODEL_CC1352R1
    bool
    select CPU_FAM_CC13X2

config CPU_MODEL_CC1352P1
    bool
    select CPU_FAM_CC13X2

## Common CPU symbols
config CPU_FAM
    default "cc13x2" if CPU_FAM_CC13X2

config CPU_MODEL
    default "cc1312r1f3" if CPU_MODEL_CC1312R1F3
    default "cc1352r1" if CPU_MODEL_CC1352R1
    default "cc1352p1" if CPU_MODEL_CC1352P1

config CPU
    default "cc26x2_cc13x2"

if USEMODULE_CC26X2_CC13X2_RF

choice
    bool "Sub-GHz frequency band"
    default CC26X2_CC13X2_RF_BAND_863_COMPAT
    help
        Frequency band of the IEEE 802.15.4 SUN FSK (MR-FSK) PHY. Select the
        band that is allowed where the device is used. The driver does not
        enforce any regulation.

config CC26X2_CC13X2_RF_BAND_863_COMPAT
    bool "863 MHz: 863-870 MHz (Europe), compatibility channel plan"
    help
        The channel plan of TI's 15.4-Stack and of RIOT's AT86RF215 driver,
        for compatibility with those radios. It is not the plan of the
        standard: channel 0 is at 863.125 MHz with 200 kHz spacing and at
        863.225 MHz with 400 kHz spacing, where the standard has 863.1 MHz
        with 100 kHz and 200 kHz spacing. A node with this plan and a node
        with the one of the standard do not hear each other.

config CC26X2_CC13X2_RF_BAND_780
    bool "780 MHz: 779-787 MHz"

config CC26X2_CC13X2_RF_BAND_863
    bool "863 MHz: 863-870 MHz (Europe), channel plan of the standard"

config CC26X2_CC13X2_RF_BAND_866
    bool "866 MHz: 865-868 MHz (India)"

config CC26X2_CC13X2_RF_BAND_867
    bool "867 MHz: 866-869 MHz (Singapore)"

config CC26X2_CC13X2_RF_BAND_870
    bool "870 MHz: 870-876 MHz (Europe)"

config CC26X2_CC13X2_RF_BAND_915
    bool "915 MHz: 902-928 MHz (North America)"

config CC26X2_CC13X2_RF_BAND_915_A
    bool "915 MHz-a: 902-928 MHz, alternate (North America and Mexico)"

config CC26X2_CC13X2_RF_BAND_915_B
    bool "915 MHz-b: 902-907.5 and 915-928 MHz (Brazil)"

config CC26X2_CC13X2_RF_BAND_915_C
    bool "915 MHz-c: 915-928 MHz (Australia and New Zealand)"

config CC26X2_CC13X2_RF_BAND_915_D
    bool "915 MHz-d: 915-921 MHz (Europe)"

config CC26X2_CC13X2_RF_BAND_915_E
    bool "915 MHz-e: 915-918 MHz (Philippines)"

config CC26X2_CC13X2_RF_BAND_917
    bool "917 MHz: 917-923.5 MHz"

config CC26X2_CC13X2_RF_BAND_919
    bool "919 MHz: 919-923 MHz (Malaysia)"

config CC26X2_CC13X2_RF_BAND_920
    bool "920 MHz: 920-928 MHz (Japan)"

config CC26X2_CC13X2_RF_BAND_920_A
    bool "920 MHz-a: 920.5-924.5 MHz (China)"

config CC26X2_CC13X2_RF_BAND_920_B
    bool "920 MHz-b: 920-925 MHz (Hong Kong, Singapore, Thailand, Vietnam)"

endchoice

# Frequency band identifier of the SUN PHY, IEEE802154_SUN_PHY_FREQ_*
config CC26X2_CC13X2_RF_SUN_PHY_FREQ
    int
    default 3 if CC26X2_CC13X2_RF_BAND_780
    default 4 if CC26X2_CC13X2_RF_BAND_863
    default 7 if CC26X2_CC13X2_RF_BAND_915
    default 8 if CC26X2_CC13X2_RF_BAND_917
    default 9 if CC26X2_CC13X2_RF_BAND_920
    default 14 if CC26X2_CC13X2_RF_BAND_866
    default 15 if CC26X2_CC13X2_RF_BAND_870
    default 16 if CC26X2_CC13X2_RF_BAND_915_A
    default 17 if CC26X2_CC13X2_RF_BAND_915_B
    default 18 if CC26X2_CC13X2_RF_BAND_915_C
    default 19 if CC26X2_CC13X2_RF_BAND_915_D
    default 20 if CC26X2_CC13X2_RF_BAND_915_E
    default 21 if CC26X2_CC13X2_RF_BAND_919
    default 22 if CC26X2_CC13X2_RF_BAND_920_A
    default 23 if CC26X2_CC13X2_RF_BAND_920_B
    default 24 if CC26X2_CC13X2_RF_BAND_867
    default 104 if CC26X2_CC13X2_RF_BAND_863_COMPAT

choice
    bool "Sub-GHz channel spacing"
    default CC26X2_CC13X2_RF_CHAN_SPACING_400 if CC26X2_CC13X2_RF_BAND_863_COMPAT
    default CC26X2_CC13X2_RF_CHAN_SPACING_200
    help
        Channel spacing of the MR-FSK PHY. The channel plan of the selected
        band follows from it (channel 0 and channel numbers). The standard
        ties the spacing to the operating mode: select the one of the mode
        that is going to be used. Only the spacings of the selected band are
        offered.

config CC26X2_CC13X2_RF_CHAN_SPACING_100
    bool "100 kHz"
    depends on CC26X2_CC13X2_RF_BAND_863 || CC26X2_CC13X2_RF_BAND_866 || \
               CC26X2_CC13X2_RF_BAND_867 || CC26X2_CC13X2_RF_BAND_870

config CC26X2_CC13X2_RF_CHAN_SPACING_200
    bool "200 kHz"

config CC26X2_CC13X2_RF_CHAN_SPACING_400
    bool "400 kHz"
    depends on !CC26X2_CC13X2_RF_BAND_863 && !CC26X2_CC13X2_RF_BAND_866 && \
               !CC26X2_CC13X2_RF_BAND_870 && !CC26X2_CC13X2_RF_BAND_920_A

config CC26X2_CC13X2_RF_CHAN_SPACING_600
    bool "600 kHz"
    depends on CC26X2_CC13X2_RF_BAND_920

endchoice

config CC26X2_CC13X2_RF_CHAN_SPACING_KHZ
    int
    default 100 if CC26X2_CC13X2_RF_CHAN_SPACING_100
    default 200 if CC26X2_CC13X2_RF_CHAN_SPACING_200
    default 400 if CC26X2_CC13X2_RF_CHAN_SPACING_400
    default 600 if CC26X2_CC13X2_RF_CHAN_SPACING_600

config CC26X2_CC13X2_RF_PA20
    bool "Use the 20 dBm PA for TX powers above the standard PA"
    help
        On a CC1352P board whose 20 dBm PA is matched for the sub-GHz band, a
        TX power above the table of the standard PA selects the 20 dBm PA.
        The driver does not check any regulation: most channels of most bands
        do not allow these powers.

endif # USEMODULE_CC26X2_CC13X2_RF

source "$(RIOTCPU)/cc26xx_cc13xx/Kconfig"
```
