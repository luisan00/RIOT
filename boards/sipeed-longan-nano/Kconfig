## boards/sipeed-longan-nano/Kconfig
```kconfig
config BOARD
    default "sipeed-longan-nano" if BOARD_SIPEED_LONGAN_NANO

config BOARD_SIPEED_LONGAN_NANO
    bool
    default y
    select CPU_MODEL_GD32VF103VBT6
    select HAS_PERIPH_RTC
    select HAS_PERIPH_RTT
    select HAS_PERIPH_TIMER
    select HAS_PERIPH_UART
```

## boards/xiao-nrf52840/Kconfig
```kconfig
config BOARD
    default "xiao-nrf52840" if BOARD_XIAO_NRF52840

config BOARD_XIAO_NRF52840
    bool
    default y
    select BOARD_COMMON_NRF52
    select CPU_MODEL_NRF52840XXAA
    select HAS_PERIPH_PWM
    select HAS_PERIPH_UART
    select HAS_PERIPH_USBDEV
    select HAS_HIGHLEVEL_STDIO

    select HAVE_SAUL_GPIO
    select HAVE_SAUL_PWM

source "$(RIOTBOARD)/common/nrf52/Kconfig"
```
